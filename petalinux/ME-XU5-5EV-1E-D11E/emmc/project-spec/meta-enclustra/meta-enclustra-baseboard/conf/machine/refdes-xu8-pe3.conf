## petalinux/ME-XU5-5EV-1E-D11E/emmc/project-spec/meta-enclustra/meta-enclustra-baseboard/conf/machine/refdes-xu8-pe3.conf
```bitbake
#@TYPE: Machine
#@NAME: refdes-xu8-pe3
#@DESCRIPTION: Machine configuration for the refdes-xu8-pe3 boards.

#### Preamble
MACHINEOVERRIDES =. "${@['', 'refdes-xu8-pe3:']['refdes-xu8-pe3' !='${MACHINE}']}"

# Required generic machine inclusion
require conf/machine/xu8-module.conf
require pe3-generic.conf

#### No additional settings should be after the Postamble
#### Postamble
PACKAGE_EXTRA_ARCHS:append = "${@['', 'refdes_xu8_pe3']['refdes-xu8-pe3' != '${MACHINE}']}"
```

## petalinux/ME-XU5-5EV-1E-D11E/emmc/project-spec/meta-enclustra/meta-enclustra-baseboard/conf/machine/refdes-xu8-st1.conf
```bitbake
#@TYPE: Machine
#@NAME: refdes-xu8-st1
#@DESCRIPTION: Machine configuration for the refdes-xu8-st1 boards.

#### Preamble
MACHINEOVERRIDES =. "${@['', 'refdes-xu8-st1:']['refdes-xu8-st1' !='${MACHINE}']}"

# Required generic machine inclusion
require conf/machine/xu8-module.conf
require st1-generic.conf

#### No additional settings should be after the Postamble
#### Postamble
PACKAGE_EXTRA_ARCHS:append = "${@['', 'refdes_xu8_st1']['refdes-xu8-st1' != '${MACHINE}']}"
```

## petalinux/ME-XU5-5EV-1E-D11E/qspi/project-spec/meta-enclustra/meta-enclustra-baseboard/conf/machine/refdes-xu9-pe3.conf
```bitbake
#@TYPE: Machine
#@NAME: refdes-xu9-pe3
#@DESCRIPTION: Machine configuration for the refdes-xu9-pe3 boards.

#### Preamble
MACHINEOVERRIDES =. "${@['', 'refdes-xu9-pe3:']['refdes-xu9-pe3' !='${MACHINE}']}"

# Required generic machine inclusion
require conf/machine/xu9-module.conf
require pe3-generic.conf

#### No additional settings should be after the Postamble
#### Postamble
PACKAGE_EXTRA_ARCHS:append = "${@['', 'refdes_xu9_pe3']['refdes-xu9-pe3' != '${MACHINE}']}"
```

## petalinux/ME-XU5-5EV-1E-D11E/sd/project-spec/meta-enclustra/meta-enclustra-module/conf/machine/xu1-module.conf
```bitbake
## preamble
MACHINEOVERRIDES =. "${@['', 'xu1-module:']['xu1-module' != '${MACHINE}']}"

## WORKAROUND: This is a workaround to allow the use of the same machine configuration for different machine types.
# This sould be taken from the xsa but looks like that doesnt works.
SOC_VARIANT = "${@'ev' if 'ev' in d.getVar('MACHINE') else 'eg' if 'eg' in d.getVar('MACHINE') else 'cg'}"

require conf/machine/zynqmp-generic.conf

## regular settings
PMU_FIRMWARE_IMAGE_NAME = "pmu-firmware-zynqmp"

## postabmle
PACKAGE_EXTRA_ARCHS:append = "${@['', ' xu1_module']['xu1-module' != "${MACHINE}"]}"
```

## petalinux/ME-XU5-5EV-2I-D12E-G1/emmc/project-spec/meta-enclustra/meta-enclustra-baseboard/conf/machine/refdes-xu6-st1.conf
```bitbake
#@TYPE: Machine
#@NAME: refdes-xu6-st1
#@DESCRIPTION: Machine configuration for the refdes-xu6-st1 boards.

#### Preamble
MACHINEOVERRIDES =. "${@['', 'refdes-xu6-st1:']['refdes-xu6-st1' !='${MACHINE}']}"

# Required generic machine inclusion
require conf/machine/xu6-module.conf
require st1-generic.conf

#### No additional settings should be after the Postamble
#### Postamble
PACKAGE_EXTRA_ARCHS:append = "${@['', 'refdes_xu6_st1']['refdes-xu6-st1' != '${MACHINE}']}"
```

## petalinux/ME-XU5-5EV-2I-D12E-G1/emmc/project-spec/meta-enclustra/meta-enclustra-baseboard/conf/machine/refdes-xu7-st1.conf
```bitbake
#@TYPE: Machine
#@NAME: refdes-xu7-st1
#@DESCRIPTION: Machine configuration for the refdes-xu7-st1 boards.

#### Preamble
MACHINEOVERRIDES =. "${@['', 'refdes-xu7-st1:']['refdes-xu7-st1' !='${MACHINE}']}"

# Required generic machine inclusion
require conf/machine/xu7-module.conf
require st1-generic.conf

#### No additional settings should be after the Postamble
#### Postamble
PACKAGE_EXTRA_ARCHS:append = "${@['', 'refdes_xu7_st1']['refdes-xu7-st1' != '${MACHINE}']}"
```

## petalinux/ME-XU5-5EV-2I-D12E-G1/emmc/project-spec/meta-enclustra/meta-enclustra-module/conf/machine/zx1-module.conf
```bitbake
## preamble
MACHINEOVERRIDES =. "${@['', 'zx1-module:']['zx1-module' != '${MACHINE}']}"

## based on
require conf/machine/zynq-generic.conf

## postabmle
PACKAGE_EXTRA_ARCHS:append = "${@['', ' zx1_module']['zx1-module' != "${MACHINE}"]}"
```

## petalinux/ME-XU5-5EV-2I-D12E-G1/qspi/project-spec/meta-enclustra/meta-enclustra-baseboard/conf/machine/refdes-xu7-pe3.conf
```bitbake
#@TYPE: Machine
#@NAME: refdes-xu7-pe3
#@DESCRIPTION: Machine configuration for the refdes-xu7-pe3 boards.

#### Preamble
MACHINEOVERRIDES =. "${@['', 'refdes-xu7-pe3:']['refdes-xu7-pe3' !='${MACHINE}']}"

# Required generic machine inclusion
require conf/machine/xu7-module.conf
require pe3-generic.conf

#### No additional settings should be after the Postamble
#### Postamble
PACKAGE_EXTRA_ARCHS:append = "${@['', 'refdes_xu7_pe3']['refdes-xu7-pe3' != '${MACHINE}']}"
```

## petalinux/ME-XU5-5EV-2I-D12E-G1/sd/project-spec/meta-enclustra/meta-enclustra-baseboard/conf/machine/refdes-xu1-pe1.conf
```bitbake
#@TYPE: Machine
#@NAME: refdes-xu1-pe1
#@DESCRIPTION: Machine configuration for the refdes-xu1-pe1 boards.

#### Preamble
MACHINEOVERRIDES =. "${@['', 'refdes-xu1-pe1:']['refdes-xu1-pe1' !='${MACHINE}']}"

# Required generic machine inclusion
require conf/machine/xu1-module.conf
require pe1-generic.conf

#### No additional settings should be after the Postamble
#### Postamble
PACKAGE_EXTRA_ARCHS:append = "${@['', 'refdes_xu1_pe1']['refdes-xu1-pe1' != '${MACHINE}']}"
```

## petalinux/ME-XU5-5EV-2I-D12E-G1/sd/project-spec/meta-enclustra/meta-enclustra-baseboard/conf/machine/refdes-xu1-pe3.conf
```bitbake
#@TYPE: Machine
#@NAME: refdes-xu1-pe3
#@DESCRIPTION: Machine configuration for the refdes-xu1-pe3 boards.

#### Preamble
MACHINEOVERRIDES =. "${@['', 'refdes-xu1-pe3:']['refdes-xu1-pe3' !='${MACHINE}']}"

# Required generic machine inclusion
require conf/machine/xu1-module.conf
require pe3-generic.conf

#### No additional settings should be after the Postamble
#### Postamble
PACKAGE_EXTRA_ARCHS:append = "${@['', 'refdes_xu1_pe3']['refdes-xu1-pe3' != '${MACHINE}']}"
```

## petalinux/ME-XU5-5EV-2I-D12E/emmc/project-spec/meta-enclustra/meta-enclustra-baseboard/conf/machine/refdes-zx1-pe3.conf
```bitbake
#@TYPE: Machine
#@NAME: refdes-zx1-pe3
#@DESCRIPTION: Machine configuration for the refdes-zx1-pe3 boards.

#### Preamble
MACHINEOVERRIDES =. "${@['', 'refdes-zx1-pe3:']['refdes-zx1-pe3' !='${MACHINE}']}"
#### Regular settings follow

## Required generic machine inclusion
require conf/machine/zx1-module.conf
require pe3-generic.conf

#### No additional settings should be after the Postamble
#### Postamble
PACKAGE_EXTRA_ARCHS:append = "${@['', 'refdes_zx1_pe3']['refdes-zx1-pe3' != '${MACHINE}']}"
```

## petalinux/ME-XU5-5EV-2I-D12E/emmc/project-spec/meta-enclustra/meta-enclustra-baseboard/conf/machine/st3-generic.conf
```bitbake
## machine.conf for the st3 carrier board

## preamble
MACHINEOVERRIDES =. "${@['', 'st3-generic:']['st3-generic' != '${MACHINE}']}"

## based on:
#require conf/machine/zynqmp-generic.conf

## postabmle
PACKAGE_EXTRA_ARCHS:append = "${@['', ' st3-generic']['st3-generic' != "${MACHINE}"]}"
```

## petalinux/ME-XU5-5EV-2I-D12E/qspi/project-spec/meta-enclustra/meta-enclustra-baseboard/conf/machine/pe1-generic.conf
```bitbake
## machine.conf for the pe1 carrier board

## preamble
MACHINEOVERRIDES =. "${@['', 'pe1-generic:']['pe1-generic' != '${MACHINE}']}"

## module based on:
#require conf/machine/zynq-generic.conf

## postabmle
PACKAGE_EXTRA_ARCHS:append = "${@['', ' pe1-generic']['pe1-generic' != "${MACHINE}"]}"
```

## petalinux/ME-XU5-5EV-2I-D12E/qspi/project-spec/meta-enclustra/meta-enclustra-baseboard/conf/machine/refdes-xu61-st1.conf
```bitbake
#@TYPE: Machine
#@NAME: refdes-xu61-st1
#@DESCRIPTION: Machine configuration for the refdes-xu61-st1 boards.

#### Preamble
MACHINEOVERRIDES =. "${@['', 'refdes-xu61-st1:']['refdes-xu61-st1' !='${MACHINE}']}"

# Required generic machine inclusion
require conf/machine/xu61-module.conf
require st1-generic.conf

#### No additional settings should be after the Postamble
#### Postamble
PACKAGE_EXTRA_ARCHS:append = "${@['', 'refdes_xu61_st1']['refdes-xu61-st1' != '${MACHINE}']}"
```

## petalinux/ME-XU5-5EV-2I-D12E/qspi/project-spec/meta-enclustra/meta-enclustra-module/conf/layer.conf
```bitbake
BBPATH .= ":${LAYERDIR}"

BBFILES += " \
${LAYERDIR}/recipes-*/*/*.bb \
${LAYERDIR}/recipes-*/*/*.bbappend \
"

BBFILE_COLLECTIONS += "meta-enclustra-module"
BBFILE_PATTERN_meta-enclustra-module = "^${LAYERDIR}/"
BBFILE_PRIORITY_meta-enclustra-module = "10"

LAYERVERSION = "1"
LAYERSERIES_COMPAT_meta-enclustra-module = "kirkstone langdale "
```

## petalinux/ME-XU5-5EV-2I-D12E/sd/project-spec/meta-enclustra/meta-enclustra-baseboard/conf/machine/refdes-xu9-pe1.conf
```bitbake
#@TYPE: Machine
#@NAME: refdes-xu9-pe1
#@DESCRIPTION: Machine configuration for the refdes-xu9-pe1 boards.

#### Preamble
MACHINEOVERRIDES =. "${@['', 'refdes-xu9-pe1:']['refdes-xu9-pe1' !='${MACHINE}']}"

# Required generic machine inclusion
require conf/machine/xu9-module.conf
require pe1-generic.conf

#### No additional settings should be after the Postamble
#### Postamble
PACKAGE_EXTRA_ARCHS:append = "${@['', 'refdes_xu9_pe1']['refdes-xu9-pe1' != '${MACHINE}']}"
```
