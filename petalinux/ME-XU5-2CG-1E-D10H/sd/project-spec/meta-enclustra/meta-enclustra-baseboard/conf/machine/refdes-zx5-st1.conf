## petalinux/ME-XU5-2CG-1E-D10H/sd/project-spec/meta-enclustra/meta-enclustra-baseboard/conf/machine/refdes-zx5-st1.conf
```bitbake
#@TYPE: Machine
#@NAME: refdes-zx5-st1
#@DESCRIPTION: Machine configuration for the refdes-zx5-st1 boards.

#### Preamble
MACHINEOVERRIDES =. "${@['', 'refdes-zx5-st1:']['refdes-zx5-st1' !='${MACHINE}']}"

# Required generic machine inclusion
require conf/machine/zx5-module.conf
require st1-generic.conf

#### No additional settings should be after the Postamble
#### Postamble
PACKAGE_EXTRA_ARCHS:append = "${@['', 'refdes_zx5_st1']['refdes-zx5-st1' != '${MACHINE}']}"
```

## petalinux/ME-XU5-2EG-1I-D11E/emmc/project-spec/meta-enclustra/meta-enclustra-baseboard/conf/machine/refdes-zx1-pe1.conf
```bitbake
#@TYPE: Machine
#@NAME: refdes-zx1-pe1
#@DESCRIPTION: Machine configuration for the refdes-zx1-pe1 boards.

#### Preamble
MACHINEOVERRIDES =. "${@['', 'refdes-zx1-pe1:']['refdes-zx1-pe1' !='${MACHINE}']}"
#### Regular settings follow

## Required generic machine inclusion
require conf/machine/zx1-module.conf
require pe1-generic.conf

#### No additional settings should be after the Postamble
#### Postamble
PACKAGE_EXTRA_ARCHS:append = "${@['', 'refdes_zx1_pe1']['refdes-zx1-pe1' != '${MACHINE}']}"
```

## petalinux/ME-XU5-2EG-1I-D11E/emmc/project-spec/meta-enclustra/meta-enclustra-baseboard/conf/machine/refdes-zx5-pe3.conf
```bitbake
#@TYPE: Machine
#@NAME: refdes-zx5-pe3
#@DESCRIPTION: Machine configuration for the refdes-zx5-pe3 boards.

#### Preamble
MACHINEOVERRIDES =. "${@['', 'refdes-zx5-pe3:']['refdes-zx5-pe3' !='${MACHINE}']}"

# Required generic machine inclusion
require conf/machine/zx5-module.conf
require pe3-generic.conf

#### No additional settings should be after the Postamble
#### Postamble
PACKAGE_EXTRA_ARCHS:append = "${@['', 'refdes_zx5_pe3']['refdes-zx5-pe3' != '${MACHINE}']}"
```

## petalinux/ME-XU5-2EG-1I-D11E/qspi/project-spec/meta-enclustra/meta-enclustra-baseboard/conf/layer.conf
```bitbake
BBPATH .= ":${LAYERDIR}"

BBFILES += " \
${LAYERDIR}/recipes-*/*/*.bb \
${LAYERDIR}/recipes-*/*/*.bbappend \
"

BBFILE_COLLECTIONS += "meta-enclustra-baseboard"
BBFILE_PATTERN_meta-enclustra-baseboard = "^${LAYERDIR}/"
BBFILE_PRIORITY_meta-enclustra-baseboard = "20"
LAYERVERSION = "1"
LAYERSERIES_COMPAT_meta-enclustra-baseboard = "kirkstone langdale "
```

## petalinux/ME-XU5-2EG-1I-D11E/qspi/project-spec/meta-enclustra/meta-enclustra-baseboard/conf/machine/refdes-xu5-pe1.conf
```bitbake
#@TYPE: Machine
#@NAME: refdes-xu5-pe1
#@DESCRIPTION: Machine configuration for the refdes-xu5-pe1 boards.

#### Preamble
MACHINEOVERRIDES =. "${@['', 'refdes-xu5-pe1:']['refdes-xu5-pe1' !='${MACHINE}']}"
#### Regular settings follow

# Required generic machine inclusion
require conf/machine/xu5-module.conf
require pe1-generic.conf

#### No additional settings should be after the Postamble
#### Postamble
PACKAGE_EXTRA_ARCHS:append = "${@['', 'refdes_xu5_pe1']['refdes-xu5-pe1' != '${MACHINE}']}"
```

## petalinux/ME-XU5-2EG-1I-D11E/sd/project-spec/meta-enclustra/meta-enclustra-module/conf/machine/xu5-module.conf
```bitbake
## preamble
MACHINEOVERRIDES =. "${@['', 'xu5-module:']['xu5-module' != '${MACHINE}']}"

## WORKAROUND: This is a workaround to allow the use of the same machine configuration for different machine types.
# This sould be taken from the xsa but looks like that doesnt works.
SOC_VARIANT = "${@'ev' if 'ev' in d.getVar('MACHINE') else 'eg' if 'eg' in d.getVar('MACHINE') else 'cg'}"

require conf/machine/zynqmp-generic.conf

## regular settings
PMU_FIRMWARE_IMAGE_NAME = "pmu-firmware-zynqmp"

## postabmle
PACKAGE_EXTRA_ARCHS:append = "${@['', ' xu5_module']['xu5-module' != "${MACHINE}"]}"
```

## petalinux/ME-XU5-3EG-2I-D11E/qspi/project-spec/meta-enclustra/meta-enclustra-baseboard/conf/machine/refdes-xu6-pe1.conf
```bitbake
#@TYPE: Machine
#@NAME: refdes-xu6-pe1
#@DESCRIPTION: Machine configuration for the refdes-xu6-pe1 boards.

#### Preamble
MACHINEOVERRIDES =. "${@['', 'refdes-xu6-pe1:']['refdes-xu6-pe1' !='${MACHINE}']}"

# Required generic machine inclusion
require conf/machine/xu6-module.conf
require pe1-generic.conf

#### No additional settings should be after the Postamble
#### Postamble
PACKAGE_EXTRA_ARCHS:append = "${@['', 'refdes_xu6_pe1']['refdes-xu6-pe1' != '${MACHINE}']}"
```

## petalinux/ME-XU5-3EG-2I-D11E/sd/project-spec/meta-enclustra/meta-enclustra-baseboard/conf/machine/refdes-xu5-pe3.conf
```bitbake
#@TYPE: Machine
#@NAME: refdes-xu5-pe3
#@DESCRIPTION: Machine configuration for the refdes-xu5-pe3 boards.

#### Preamble
MACHINEOVERRIDES =. "${@['', 'refdes-xu5-pe3:']['refdes-xu5-pe3' !='${MACHINE}']}"
#### Regular settings follow

# Required generic machine inclusion
require conf/machine/xu5-module.conf
require pe3-generic.conf

#### No additional settings should be after the Postamble
#### Postamble
PACKAGE_EXTRA_ARCHS:append = "${@['', 'refdes_xu5_pe3']['refdes-xu5-pe3' != '${MACHINE}']}"
```

## petalinux/ME-XU5-4CG-1E-D11E-G1/qspi/project-spec/meta-enclustra/meta-enclustra-module/conf/machine/zx2-module.conf
```bitbake
## preamble
MACHINEOVERRIDES =. "${@['', 'zx2-module:']['zx2-module' != '${MACHINE}']}"

## based on
require conf/machine/zynq-generic.conf

## postabmle
PACKAGE_EXTRA_ARCHS:append = "${@['', ' zx2_module']['zx2-module' != "${MACHINE}"]}"
```

## petalinux/ME-XU5-4EV-1I-D11E-G1/emmc/project-spec/meta-enclustra/meta-enclustra-baseboard/conf/machine/refdes-xu7-pe1.conf
```bitbake
#@TYPE: Machine
#@NAME: refdes-xu7-pe1
#@DESCRIPTION: Machine configuration for the refdes-xu7-pe1 boards.

#### Preamble
MACHINEOVERRIDES =. "${@['', 'refdes-xu7-pe1:']['refdes-xu7-pe1' !='${MACHINE}']}"

# Required generic machine inclusion
require conf/machine/xu7-module.conf
require pe1-generic.conf

#### No additional settings should be after the Postamble
#### Postamble
PACKAGE_EXTRA_ARCHS:append = "${@['', 'refdes_xu7_pe1']['refdes-xu7-pe1' != '${MACHINE}']}"
```

## petalinux/ME-XU5-4EV-1I-D11E-G1/emmc/project-spec/meta-enclustra/meta-enclustra-module/conf/machine/zx3-module.conf
```bitbake
## preamble
MACHINEOVERRIDES =. "${@['', 'zx3-module:']['zx3-module' != '${MACHINE}']}"

## based on
require conf/machine/zynq-generic.conf

## postabmle
PACKAGE_EXTRA_ARCHS:append = "${@['', ' zx3_module']['zx3-module' != "${MACHINE}"]}"
```

## petalinux/ME-XU5-4EV-1I-D11E-G1/qspi/project-spec/meta-enclustra/meta-enclustra-baseboard/conf/machine/refdes-zx2-st3.conf
```bitbake
#@TYPE: Machine
#@NAME: refdes-zx2-st3
#@DESCRIPTION: Machine configuration for the refdes-zx2-st3 boards.

#### Preamble
MACHINEOVERRIDES =. "${@['', 'refdes-zx2-st3:']['refdes-zx2-st3' !='${MACHINE}']}"

# Required generic machine inclusion
require conf/machine/zx2-module.conf
require st3-generic.conf

#### No additional settings should be after the Postamble
#### Postamble
PACKAGE_EXTRA_ARCHS:append = "${@['', 'refdes_zx2_st3']['refdes-zx2-st3' != '${MACHINE}']}"
```

## petalinux/ME-XU5-4EV-1I-D11E-G1/qspi/project-spec/meta-enclustra/meta-enclustra-baseboard/conf/machine/refdes-zx5-pe1.conf
```bitbake
#@TYPE: Machine
#@NAME: refdes-zx5-pe1
#@DESCRIPTION: Machine configuration for the refdes-zx5-pe1 boards.

#### Preamble
MACHINEOVERRIDES =. "${@['', 'refdes-zx5-pe1:']['refdes-zx5-pe1' !='${MACHINE}']}"

# Required generic machine inclusion
require conf/machine/zx5-module.conf
require pe1-generic.conf

#### No additional settings should be after the Postamble
#### Postamble
PACKAGE_EXTRA_ARCHS:append = "${@['', 'refdes_zx5_pe1']['refdes-zx5-pe1' != '${MACHINE}']}"
```

## petalinux/ME-XU5-4EV-1I-D11E-G1/qspi/project-spec/meta-enclustra/meta-enclustra-baseboard/conf/machine/st1-generic.conf
```bitbake
## machine.conf for the st1 carrier board

## preamble
MACHINEOVERRIDES =. "${@['', 'st1-generic:']['st1-generic' != '${MACHINE}']}"

## based on:
#require conf/machine/zynqmp-generic.conf

## postabmle
PACKAGE_EXTRA_ARCHS:append = "${@['', ' st1-generic']['st1-generic' != "${MACHINE}"]}"
```

## petalinux/ME-XU5-4EV-1I-D11E-G1/qspi/project-spec/meta-enclustra/meta-enclustra-module/conf/machine/zx5-module.conf
```bitbake
## preamble
MACHINEOVERRIDES =. "${@['', 'zx5-module:']['zx5-module' != '${MACHINE}']}"

## based on
require conf/machine/zynq-generic.conf

## postabmle
PACKAGE_EXTRA_ARCHS:append = "${@['', ' zx5_module']['zx5-module' != "${MACHINE}"]}"
```

## petalinux/ME-XU5-4EV-1I-D11E-G1/sd/project-spec/meta-enclustra/meta-enclustra-baseboard/conf/machine/refdes-xzu65-st1.conf
```bitbake
#@TYPE: Machine
#@NAME: refdes-xzu65-st1
#@DESCRIPTION: Machine configuration for the refdes-xzu65-st1 boards.

#### Preamble
MACHINEOVERRIDES =. "${@['', 'refdes-xzu65-st1:']['refdes-xzu65-st1' !='${MACHINE}']}"

# Required generic machine inclusion
require conf/machine/xzu65-module.conf
require st1-generic.conf

#### No additional settings should be after the Postamble
#### Postamble
PACKAGE_EXTRA_ARCHS:append = "${@['', 'refdes_xzu65_st1']['refdes-xzu65-st1' != '${MACHINE}']}"
```

## petalinux/ME-XU5-4EV-1I-D11E-G1/sd/project-spec/meta-enclustra/meta-enclustra-baseboard/conf/machine/refdes-zx3-st3.conf
```bitbake
#@TYPE: Machine
#@NAME: refdes-zx3-st3
#@DESCRIPTION: Machine configuration for the refdes-zx3-st3 boards.

#### Preamble
MACHINEOVERRIDES =. "${@['', 'refdes-zx3-st3:']['refdes-zx3-st3' !='${MACHINE}']}"

# Required generic machine inclusion
require conf/machine/zx3-module.conf
require st3-generic.conf

#### No additional settings should be after the Postamble
#### Postamble
PACKAGE_EXTRA_ARCHS:append = "${@['', 'refdes_zx3_st3']['refdes-zx3-st3' != '${MACHINE}']}"
```

## petalinux/ME-XU5-4EV-1I-D11E/qspi/project-spec/meta-enclustra/meta-enclustra-baseboard/conf/machine/refdes-xu3-st3.conf
```bitbake
#@TYPE: Machine
#@NAME: refdes-xu3-st3
#@DESCRIPTION: Machine configuration for the refdes-xu3-st3 boards.

#### Preamble
MACHINEOVERRIDES =. "${@['', 'refdes-xu3-st3:']['refdes-xu3-st3' !='${MACHINE}']}"

# Required generic machine inclusion
require conf/machine/xu3-module.conf
require st3-generic.conf

#### No additional settings should be after the Postamble
#### Postamble
PACKAGE_EXTRA_ARCHS:append = "${@['', 'refdes_xu3_st3']['refdes-xu3-st3' != '${MACHINE}']}"
```

## petalinux/ME-XU5-4EV-1I-D11E/sd/project-spec/meta-enclustra/meta-enclustra-baseboard/conf/machine/pe3-generic.conf
```bitbake
## machine.conf for the pe3 carrier board

## preamble
MACHINEOVERRIDES =. "${@['', 'pe3-generic:']['pe3-generic' != '${MACHINE}']}"

## module based on:
#require conf/machine/zynq-generic.conf

## postabmle
PACKAGE_EXTRA_ARCHS:append = "${@['', ' pe3-generic']['pe3-generic' != "${MACHINE}"]}"
```

## petalinux/ME-XU5-4EV-1I-D11E/sd/project-spec/meta-enclustra/meta-enclustra-baseboard/conf/machine/refdes-xu1-st1.conf
```bitbake
#@TYPE: Machine
#@NAME: refdes-xu1-st1
#@DESCRIPTION: Machine configuration for the refdes-xu1-st1 boards.

#### Preamble
MACHINEOVERRIDES =. "${@['', 'refdes-xu1-st1:']['refdes-xu1-st1' !='${MACHINE}']}"

# Required generic machine inclusion
require conf/machine/xu1-module.conf
require st1-generic.conf

#### No additional settings should be after the Postamble
#### Postamble
PACKAGE_EXTRA_ARCHS:append = "${@['', 'refdes_xu1_st1']['refdes-xu1-st1' != '${MACHINE}']}"
```

## petalinux/ME-XU5-4EV-1I-D11E/sd/project-spec/meta-enclustra/meta-enclustra-baseboard/conf/machine/refdes-xu9-st1.conf
```bitbake
#@TYPE: Machine
#@NAME: refdes-xu9-st1
#@DESCRIPTION: Machine configuration for the refdes-xu9-st1 boards.

#### Preamble
MACHINEOVERRIDES =. "${@['', 'refdes-xu9-st1:']['refdes-xu9-st1' !='${MACHINE}']}"

# Required generic machine inclusion
require conf/machine/xu9-module.conf
require st1-generic.conf

#### No additional settings should be after the Postamble
#### Postamble
PACKAGE_EXTRA_ARCHS:append = "${@['', 'refdes_xu9_st1']['refdes-xu9-st1' != '${MACHINE}']}"
```

## petalinux/ME-XU5-4EV-1I-D11E/sd/project-spec/meta-enclustra/meta-enclustra-baseboard/conf/machine/refdes-zx1-st1.conf
```bitbake
#@TYPE: Machine
#@NAME: refdes-zx1-st1
#@DESCRIPTION: Machine configuration for the refdes-zx1-st1 boards.

#### Preamble
MACHINEOVERRIDES =. "${@['', 'refdes-zx1-st1:']['refdes-zx1-st1' !='${MACHINE}']}"
#### Regular settings follow

## Required generic machine inclusion
require conf/machine/zx1-module.conf
require st1-generic.conf

#### No additional settings should be after the Postamble
#### Postamble
PACKAGE_EXTRA_ARCHS:append = "${@['', 'refdes_zx1_st1']['refdes-zx1-st1' != '${MACHINE}']}"
```

## petalinux/ME-XU5-5EV-1E-D11E/emmc/project-spec/meta-enclustra/meta-enclustra-baseboard/conf/machine/refdes-xu5-st1.conf
```bitbake
#@TYPE: Machine
#@NAME: refdes-xu5-st1
#@DESCRIPTION: Machine configuration for the refdes-xu5-st1 boards.

#### Preamble
MACHINEOVERRIDES =. "${@['', 'refdes-xu5-st1:']['refdes-xu5-st1' !='${MACHINE}']}"

# Required generic machine inclusion
require conf/machine/xu5-module.conf
require st1-generic.conf

#### No additional settings should be after the Postamble
#### Postamble
PACKAGE_EXTRA_ARCHS:append = "${@['', 'refdes_xu5_st1']['refdes-xu5-st1' != '${MACHINE}']}"
```

## petalinux/ME-XU5-5EV-1E-D11E/emmc/project-spec/meta-enclustra/meta-enclustra-baseboard/conf/machine/refdes-xu6-pe3.conf
```bitbake
#@TYPE: Machine
#@NAME: refdes-xu6-pe3
#@DESCRIPTION: Machine configuration for the refdes-xu6-pe3 boards.

#### Preamble
MACHINEOVERRIDES =. "${@['', 'refdes-xu6-pe3:']['refdes-xu6-pe3' !='${MACHINE}']}"

# Required generic machine inclusion
require conf/machine/xu6-module.conf
require pe3-generic.conf

#### No additional settings should be after the Postamble
#### Postamble
PACKAGE_EXTRA_ARCHS:append = "${@['', 'refdes_xu6_pe3']['refdes-xu6-pe3' != '${MACHINE}']}"
```

## petalinux/ME-XU5-5EV-1E-D11E/emmc/project-spec/meta-enclustra/meta-enclustra-baseboard/conf/machine/refdes-xu61-pe1.conf
```bitbake
#@TYPE: Machine
#@NAME: refdes-xu61-pe1
#@DESCRIPTION: Machine configuration for the refdes-xu61-pe1 boards.

#### Preamble
MACHINEOVERRIDES =. "${@['', 'refdes-xu61-pe1:']['refdes-xu61-pe1' !='${MACHINE}']}"

# Required generic machine inclusion
require conf/machine/xu61-module.conf
require pe1-generic.conf

#### No additional settings should be after the Postamble
#### Postamble
PACKAGE_EXTRA_ARCHS:append = "${@['', 'refdes_xu61_pe1']['refdes-xu61-pe1' != '${MACHINE}']}"
```
