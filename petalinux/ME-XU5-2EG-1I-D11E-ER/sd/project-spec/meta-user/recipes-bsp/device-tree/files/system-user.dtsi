/include/ "system-conf.dtsi"
/ {
	model = "Enclustra ME-XU5-2EG-1I-D11E-ER SOM";
};
#include "zynqmp_enclustra_common.dtsi"
#include "zynqmp_enclustra_mercury_xu5_er.dtsi"
#include "zynqmp_enclustra_mercury_st1.dtsi"
