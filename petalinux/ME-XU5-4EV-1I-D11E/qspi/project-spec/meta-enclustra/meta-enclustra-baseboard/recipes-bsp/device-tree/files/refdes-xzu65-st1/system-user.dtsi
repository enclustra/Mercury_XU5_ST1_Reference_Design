/include/ "system-conf.dtsi"
/ {
	model = "Enclustra XZU65 SOM";
};
#include "zynqmp_enclustra_common.dtsi"
#include "zynqmp_enclustra_andromeda_xzu65.dtsi"
#include "zynqmp_enclustra_mercury_st1.dtsi"
