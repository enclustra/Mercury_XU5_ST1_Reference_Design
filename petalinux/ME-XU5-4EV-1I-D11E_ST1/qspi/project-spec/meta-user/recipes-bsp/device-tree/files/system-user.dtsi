/include/ "system-conf.dtsi"
/ {
	model = "Enclustra ME-XU5-4EV-1I-D11E SOM";
};
#include "zynqmp_enclustra_common.dtsi"
#include "zynqmp_enclustra_mercury_st1.dtsi"
#include "zynqmp_enclustra_mercury_xu5.dtsi"
